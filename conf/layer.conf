## conf/layer.conf
```bitbake
# We have a conf and classes directory, add to BBPATH
BBPATH .= ":${LAYERDIR}"

# We have recipes-* directories, add to BBFILES
BBFILES += "${LAYERDIR}/recipes-*/*/*.bb \
        ${LAYERDIR}/recipes-*/*/*.bbappend"

BBFILE_COLLECTIONS += "meta-intel"
BBFILE_PATTERN_meta-intel = "^${LAYERDIR}/"
BBFILE_PRIORITY_meta-intel = "5"
LAYERSERIES_COMPAT_meta-intel = "kirkstone langdale"

IMAGE_FEATURES[validitems] += "tools-sdk tools-debug validation-unsecure"

# static userid assignments
USERADDEXTENSION = "useradd-staticids"
USERADD_UID_TABLES = "files/passwd"
USERADD_GID_TABLES = "files/group"

LAYER_CONF_VERSION = "15"

DISTRO_FEATURES:remove = " avahi slp"
```

## meta-ctl/conf/machine/intel-ast2600.conf
```bitbake
require conf/machine/include/intel-ast2600.inc

#TODO CTL: replace dtb with CTL
KERNEL_DEVICETREE += " \
    ${KMACHINE}-bmc-${COMPATIBLE_MACHINE}-acm.dtb \
    "
SECURE_BOOT_CONFIG_SELECT ?="${@bb.utils.contains_any("EXTRA_IMAGE_FEATURES", "RSA2048-keys", "ast2600-secure-rsa2048-sha256.conf", "ast2600-secure-rsa3072-sha384.conf", d)}"
include conf/machine/${SECURE_BOOT_CONFIG_SELECT}
```
